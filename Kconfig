## Kconfig
```kconfig
# Custom modules provided by this zmk-config repo, built as a Zephyr module.

config ZMK_LAYER_STATE_RPC
    bool "Report overlay state to the host over ZMK Studio RPC"
    default y
    depends on ZMK_STUDIO_RPC
    depends on !ZMK_SPLIT || (ZMK_SPLIT && ZMK_SPLIT_ROLE_CENTRAL)
    help
      레이어가 바뀔 때마다 활성 레이어 비트마스크를 Studio RPC 알림으로
      호스트에 보내고, 물리 키의 press/release position도 raw position
      이벤트 단계에서 알린다. 호스트가 현재 레이어 상태를 물어볼 수 있는
      요청 핸들러도 함께 등록한다(core.proto의 active_layers_changed /
      get_active_layers / position_state_changed - proto 저장소 포크에서 추가).

      예전에는 안 쓰는 F키를 실제로 눌러 보내는 마커 방식이었으나(구
      ZMK_LAYER_MARKER), 그건 진짜 HID 키 입력이라 포커스된 모든 앱이
      받았고 터미널에서 sudo 비밀번호 프롬프트가 깨졌다. 이쪽은 키 입력을
      전혀 보내지 않으므로 다른 앱에 영향이 없다.

      proto 필드가 필요하므로 config/west.yml에서 zmk-studio-messages를
      포크로 덮어쓴 상태여야 빌드된다.
```

## dts/bindings/behaviors/zmk,behavior-traceable-mo.yaml
```yaml
# Copyright (c) 2026
# SPDX-License-Identifier: MIT

description: |
  Momentary layer on press/release, identical to the stock &mo, except it
  also emits an unused F-key (F20 + layer number) as an invisible marker when
  pressed, so a host application can tell which layer was just activated.

  ZMK Studio's RPC exposes only core/behaviors/keymap subsystems and has no
  key-event or layer-state notification at all, so a desktop overlay has no
  other way to know which layer is currently active. This behavior makes the
  keyboard volunteer that information over the one channel it always has:
  the keystrokes it is already sending (same idea as scylla-zmk-config's
  behavior_status_report.c, applied to layer activation instead of
  connection/battery status). The marker key has no default binding in any
  mainstream OS, so it produces no visible effect during normal typing.

compatible: "zmk,behavior-traceable-mo"

include: one_param.yaml

properties:
  locking:
    type: boolean
    description: Whether to "lock" the layer active, same as &mo's locking property.
```
